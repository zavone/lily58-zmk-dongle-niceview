/*
 * Copyright (c) 2020 Pete Johanson
 *
 * SPDX-License-Identifier: MIT
 */

#include <nordic/nrf52840_qiaa.dtsi>
#include "promicro_nrf52840-pinctrl.dtsi"
#include "promicro_nrf52840_nrf52840.dtsi"
// vim: set ft=dts :
